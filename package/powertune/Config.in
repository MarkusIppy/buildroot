## package/powertune/Config.in
```kconfig
config BR2_PACKAGE_POWERTUNE
        bool "powertune"
        depends on BR2_PACKAGE_QT5
        select BR2_PACKAGE_QT5BASE_WIDGETS
        depends on BR2_PACKAGE_QT5
        select BR2_PACKAGE_QT5BASE_WIDGETS
	depends on BR2_PACKAGE_QT5DECLARATIVE
	select BR2_PACKAGE_QT5DECLARATIVE
	depends on BR2_PACKAGE_QT5DECLARATIVE_QUICK
	select BR2_PACKAGE_QT5DECLARATIVE_QUICK
	depends on BR2_PACKAGE_QT5GRAPHICALEFFECTS
	select BR2_PACKAGE_QT5GRAPHICALEFFECTS
	depends on BR2_PACKAGE_QT5IMAGEFORMATS
	select BR2_PACKAGE_QT5IMAGEFORMATS
	depends on BR2_PACKAGE_QT5LOCATION
	select BR2_PACKAGE_QT5LOCATION
	depends on BR2_PACKAGE_QT5MULTIMEDIA
	select BR2_PACKAGE_QT5MULTIMEDIA
	depends on BR2_PACKAGE_QT5QUICKCONTROLS
	select BR2_PACKAGE_QT5QUICKCONTROLS
	depends on BR2_PACKAGE_QT5QUICKCONTROLS2
	select BR2_PACKAGE_QT5QUICKCONTROLS2
	depends on BR2_PACKAGE_QT5SERIALBUS
	select BR2_PACKAGE_QT5SERIALBUS
	depends on BR2_PACKAGE_QT5SERIALPORT
	select BR2_PACKAGE_QT5SERIALPORT
        help
          Qt5 ECU Info viewer.

          
```
